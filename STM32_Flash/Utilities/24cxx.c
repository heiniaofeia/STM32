/**
  ******************************************************************************
  * @file    24Cxx.c
  * @author  Long 
  * @version V1.0
  * @date    2015-xx-xx
  * @brief   用gpio模拟i2c总线, 适用于STM32系列CPU。该模块不包括应用层命令帧，仅包括I2C总线基本操作函数。
  ******************************************************************************
  * @attention
  *
  * 实验平台:主控板 MINI STM32
  * 
  ******************************************************************************
  */ 
#include "24cxx.h" 



/*********************************************************************************************************
*	函 数 名: AT24CXX_Init
*	功能说明: 初始化IIC接口
*	形    参：无
*	返 回 值: 无
*********************************************************************************************************/
void AT24CXX_Init(void)
{
	IIC_Init();
}


/*********************************************************************************************************
*	函 数 名: AT24CXX_ReadOneByte
*	功能说明: 在AT24CXX指定地址读出一个数据
*	形    参：ReadAddr:开始读数的地址  
*	返 回 值: 读到的数据
*********************************************************************************************************/
u8 AT24CXX_ReadOneByte(u16 ReadAddr)
{				  
	u8 temp=0;	
	
    IIC_Start();  
	if(EE_TYPE > AT24C16)
	{
		IIC_Send_Byte(0XA0);	   		//发送写命令
		IIC_Wait_Ack();
		IIC_Send_Byte(ReadAddr >> 8);	//发送高地址
		IIC_Wait_Ack();		 
	}
	else IIC_Send_Byte(0XA0 + ((ReadAddr / 256) << 1));   //发送器件地址0XA0,写数据 	 

	
	IIC_Wait_Ack(); 
    IIC_Send_Byte(ReadAddr % 256);   	//发送低地址
	IIC_Wait_Ack();	    
	IIC_Start();  	 	   
	IIC_Send_Byte(0XA1);           		//进入接收模式			   
	IIC_Wait_Ack();	 
    temp=IIC_Read_Byte(0);		   
    IIC_Stop();							//产生一个停止条件	    
	return temp;
}


/*********************************************************************************************************
*	函 数 名: AT24CXX_Init
*	功能说明: 在AT24CXX指定地址写入数据
*	形    参：要写入的数据 
*	返 回 值: 无
*********************************************************************************************************/
void AT24CXX_WriteOneByte(u16 WriteAddr, u8 DataToWrite)
{				   	  	    																 
    IIC_Start(); 
	
	if(EE_TYPE > AT24C16)
	{
		IIC_Send_Byte(0XA0);	    //发送写命令
		IIC_Wait_Ack();
		IIC_Send_Byte(WriteAddr >> 8);//发送高地址
 	}
	else
	{
		IIC_Send_Byte(0XA0 + ((WriteAddr / 256) << 1));   //发送器件地址0XA0,写数据 
	}	 
	IIC_Wait_Ack();	   
    IIC_Send_Byte(WriteAddr % 256);   	//发送低地址
	IIC_Wait_Ack(); 	 										  		   
	IIC_Send_Byte(DataToWrite);     	//发送字节							   
	IIC_Wait_Ack();  		    	   
    IIC_Stop();							//产生一个停止条件 
//	Delay_us(4);
}


/*********************************************************************************************************
*	函 数 名: AT24CXX_WriteLenByte
*	功能说明: 在AT24CXX里面的指定地址开始写入长度为Len的数据,该函数用于写入16bit或者32bit的数据.
*	形    参：WriteAddr:开始写入的地址; DataToWrite:数据数组首地址; Len:要写入数据的长度2,4 
*	返 回 值: 无
*********************************************************************************************************/
void AT24CXX_WriteLenByte(u16 WriteAddr, u32 DataToWrite, u8 Len)
{  	
	u8 t;
	for(t = 0; t < Len; t++)
	{
		AT24CXX_WriteOneByte(WriteAddr + t, (DataToWrite >> (8 * t)) & 0xff);
	}												    
}


/*********************************************************************************************************
*	函 数 名: AT24CXX_ReadLenByte
*	功能说明: 在AT24CXX里面的指定地址开始读出长度为Len的数据,该函数用于读出16bit或者32bit的数据.
*	形    参：ReadAddr:开始读出的地址;Len:要读出数据的长度2,4 
*	返 回 值: 数据
*********************************************************************************************************/
u32 AT24CXX_ReadLenByte(u16 ReadAddr, u8 Len)
{  	
	u8 t;
	u32 temp = 0;
	for(t = 0; t < Len; t++)
	{
		temp <<= 8;
		Delay_us(2);
		temp += AT24CXX_ReadOneByte(ReadAddr + Len - t - 1);
		
	}
	return temp;												    
}


/*********************************************************************************************************
*	函 数 名: AT24CXX_Check
*	功能说明: 检查AT24CXX是否正常,这里用了24XX的最后一个地址(255)来存储标志字.如果用其他24C系列,这个地址要修改
*	形    参：ReadAddr:开始读出的地址;Len:要读出数据的长度2,4 
*	返 回 值: 返回1:检测失败;返回0:检测成功
*********************************************************************************************************/
u8 AT24CXX_Check(void)
{
	u8 temp;
	temp = AT24CXX_ReadOneByte(255);	//避免每次开机都写AT24CXX			   
	if(temp == 0X55)return 0;		   
	else								//排除第一次初始化的情况
	{
		AT24CXX_WriteOneByte(255, 0X55);
	    temp = AT24CXX_ReadOneByte(255);	  
		if(temp == 0X55)return 0;
	}
	return 1;											  
}


/*********************************************************************************************************
*	函 数 名: AT24CXX_Read
*	功能说明: 在AT24CXX里面的指定地址开始读出指定个数的数据
*	形    参：ReadAddr :开始读出的地址 对24c02为0~255; pBuffer:数据数组首地址; NumToRead:要读出数据的个数
*	返 回 值: 无
*********************************************************************************************************/
void AT24CXX_Read(u16 ReadAddr,u8 *pBuffer,u16 NumToRead)
{
	while(NumToRead)
	{
		*pBuffer++ = AT24CXX_ReadOneByte(ReadAddr++);	
		NumToRead--;
	}
}  


/*********************************************************************************************************
*	函 数 名: AT24CXX_Write
*	功能说明: 在AT24CXX里面的指定地址开始写入指定个数的数据
*	形    参：WriteAddr:开始读出的地址 对24c02为0~255; pBuffer:数据数组首地址; NumToRead:要写入数据的个数
*	返 回 值: 无
*********************************************************************************************************/
void AT24CXX_Write(u16 WriteAddr,u8 *pBuffer,u16 NumToWrite)
{
	while(NumToWrite--)
	{
		AT24CXX_WriteOneByte(WriteAddr, *pBuffer);
		WriteAddr++;
		pBuffer++;
		Delay_us(150);						//当要一次性写入很多的数据时，至少需要延时150us
	}
}
 


